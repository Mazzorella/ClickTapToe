## Kconfig
```kconfig
menuconfig CLICKTAPTOE_AS5600_SCROLL
    bool "ClickTapToe AS5600 scroll sensor"
    default y
    depends on DT_HAS_CLICKTAPTOE_AS5600_SCROLL_ENABLED
    depends on I2C
    help
      Enable the AS5600 magnetic angle sensor as a ZMK rotation sensor for
      ClickTapToe scrolling.

if CLICKTAPTOE_AS5600_SCROLL

config CLICKTAPTOE_AS5600_SCROLL_INIT_PRIORITY
    int "ClickTapToe AS5600 scroll initialization priority"
    default SENSOR_INIT_PRIORITY

module = CLICKTAPTOE_AS5600_SCROLL
module-str = CLICKTAPTOE_AS5600_SCROLL
source "${ZEPHYR_BASE}/subsys/logging/Kconfig.template.log_config"

endif

menuconfig CLICKTAPTOE_STATUS_LED
    bool "ClickTapToe onboard status LED"
    default y
    depends on GPIO
    help
      Use the XIAO BLE onboard RGB LED to report ClickTapToe firmware health
      and local input activity.

if CLICKTAPTOE_STATUS_LED

config CLICKTAPTOE_STATUS_LED_INIT_PRIORITY
    int "ClickTapToe status LED initialization priority"
    default APPLICATION_INIT_PRIORITY

config CLICKTAPTOE_STATUS_LED_STARTUP_DELAY_MS
    int "ClickTapToe status LED startup check delay in milliseconds"
    default 750

config CLICKTAPTOE_STATUS_LED_HEALTH_CHECK_MS
    int "ClickTapToe status LED health check interval in milliseconds"
    default 1000

config CLICKTAPTOE_STATUS_LED_ERROR_BLINK_MS
    int "ClickTapToe status LED error blink interval in milliseconds"
    default 750

config CLICKTAPTOE_STATUS_LED_ACTIVITY_PULSE_MS
    int "ClickTapToe status LED activity pulse length in milliseconds"
    default 100

module = CLICKTAPTOE_STATUS_LED
module-str = CLICKTAPTOE_STATUS_LED
source "${ZEPHYR_BASE}/subsys/logging/Kconfig.template.log_config"

endif
```

## boards/shields/clicktaptoe/Kconfig.defconfig
```kconfig
if SHIELD_CLICKTAPTOE

config ZMK_KEYBOARD_NAME
    default "ClickTapToe"

config ZMK_POINTING
    default y

endif
```

## dts/bindings/sensor/clicktaptoe,as5600-scroll.yaml
```yaml
description: |
  ClickTapToe AS5600 magnetic scroll wheel adapter.

compatible: "clicktaptoe,as5600-scroll"

include: [sensor-device.yaml, i2c-device.yaml]

properties:
  poll-ms:
    type: int
    default: 8
    description: Polling interval in milliseconds.

  deadband:
    type: int
    default: 0
    description: Raw 12-bit AS5600 counts to ignore per sample as idle jitter.

  invert:
    type: boolean
    description: Invert reported scroll direction.
```
